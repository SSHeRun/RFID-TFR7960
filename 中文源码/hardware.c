/**********************************************************************************************************************************************************
* 文 件 名：HARDWARE.C
* 功    能：RFID阅读器TRF7960与MSP430F2370微控制器之间的硬件连接。
* 硬件连接：MSP430F2370与TRF7960的硬件连接关系如下所示：
*               MSP430F2370                 TRF7960
*********************    PARALLEL INTERFACE    ******************************************
*               P4.0(Pin26)                 DATA0(Pin17)
*               P4.1(Pin27)                 DATA1(Pin18)
*               P4.2(Pin28)                 DATA2(Pin19)
*               P4.3(Pin29)                 DATA3(Pin20)
*               P4.4(Pin30)                 DATA4(Pin21)
*               P4.5(Pin31)                 DATA5(Pin22)
*               P4.6(Pin32)                 DATA6(Pin23)
*               P4.7(Pin33)                 DATA7(Pin24)
*********************    FUNCTION INTERFACE    ******************************************
*               P2.0(Pin12)                 MOD(Pin14)
*               P2.1(Pin13)                 IRQ(Pin13)
*               P2.2(Pin14)                 ASK/OOK(Pin12)
*
*               P1.0(Pin4)                  EN(Pin28)
*               XIN/P2.6(Pin2)              SYS_CLK(Pin27)
*********************    SERIAL(SPI) INTERFACE    ***************************************           
*               P3.0(Pin18)                 Slave_select(Pin21)
*               P3.1(Pin19)                 SIMO(Pin24)
*               P3.2(Pin20)                 SOMI(Pin23)
*               P3.3(Pin21)                 DATA_CLK(Pin26)
*
* 作    者：EMDOOR
* 日    期：2011年04月13号
**********************************************************************************************************************************************************/
#include "hardware.h"
#include "communicate.h"


/******************************************************************************************************************
* 函数名称：delay_ms()
* 功    能：延时函数。
* 入口参数：n_ms        毫秒值
* 出口参数：无
* 说    明：该函数为延时函数，入口参数值越大，CPU延时等待的时间就越长。
*           本演示程序，将其应用于非精确的延时等待场合。
*           注意：入口参数的最大值为 65536。           
*******************************************************************************************************************/
void delay_ms(unsigned int n_ms)
{
    unsigned int ii1, ii0;
    
    for(ii0=n_ms; ii0>0; ii0--) 
    {
        ii1 = 0x07FF;                               //单循环延时参数。为估计值，不能精确延时。
        do (ii1--);
        while (ii1 != 0);
    }
}


/******************************************************************************************************************
* 函数名称：CounterSet()
* 功    能：定时器设置函数。
* 入口参数：无
* 出口参数：无
* 说    明：初始化设置定时器寄存器。 本演示程序，将其应用于精确的延时等待场合。          
*******************************************************************************************************************/
void CounterSet(void)
{
    TACTL |= TACLR;
    TACTL &= ~TACLR;                                //复位定时器A
    TACTL |= TASSEL0 + ID1 + ID0;                   //选择主时钟ACLK, 8分频, 中断使能, 定时器关
    
    TAR = 0x0000;
    TACCTL0 |= CCIE;                                //比较中断使能
}

/******************************************************************************************************************
* 函数名称：OSCsel()
* 功    能：晶体振荡器选择
* 入口参数：mode        选择内部或者外部模式
* 出口参数：无
* 说    明：配置晶体振荡器模式。若入口参数为0x00，则选择外部晶体模式。
*           若为非0x00的任意值，则选择内部DCO模式。
*******************************************************************************************************************/
void OSCsel(unsigned char mode)
{
    unsigned int ii1;

    if(mode == 0x00)                                //选择晶体振荡器
    {   
        BCSCTL1 |= XTS + XT2OFF;                    //XTS置位表示高频率模式；XT2OFF表示振荡器2关闭
        BCSCTL3 |= LFXT1S1;                         //外部数字时钟源0.4 - 16MHz
        
        do                                          //将外部晶体振荡器打开
        {
            IFG1 &= ~OFIFG;                         // 清除晶体默认设置标志 OFIFG
            for (ii1 = 0xFF; ii1 > 0; ii1--);       // 延时等待标志位设立
        }
        while ((IFG1 & OFIFG) == OFIFG);            // 判断标志位OFIFG是否设定
        BCSCTL2 |= SELM1 + SELM0 + SELS;            // 主振荡器MCLK = SMCLK = HF LFXT1 (成功设置)

        return;
    }

    else                                            //选择内部DCO为主振荡器
    {
        BCSCTL2 &= ~(SELM1 + SELM0 + SELS + DCOR);
        BCSCTL1 = CALBC1_8MHZ;                      //设置内部DCO频率为8MHz
        DCOCTL = CALDCO_8MHZ;
        UCA0CTL1 |= UCSSEL_2;                       //SMCLK
    
        return;
    }
}

/******************************************************************************************************************
* 函数名称：TimerAhandler()
* 功    能：定时器中断服务程序
* 入口参数：无
* 出口参数：无
* 说    明：定时器中断服务程序，用于精确延时用。
*******************************************************************************************************************/
#pragma vector=TIMERA0_VECTOR
__interrupt void TimerAhandler(void)
{   
    unsigned char Register[2];

    StopCounter();
    
    /* 读取IRQ中断状态寄存器 */
    /*====================================================================================================*/
    Register[0] = IRQStatus;                        //IRQ中断状态寄存器地址
    Register[1] = IRQMask;                          //虚拟读(Dummy read)    
    ReadCont(Register, 2);
    /*====================================================================================================*/
    
    *Register = *Register & 0xF7;                   //设置奇偶校验位B3为0，过滤其余位
    if(*Register == 0x00 || *Register == 0x80)      //判断是否时间到
        i_reg = 0x00;
    else                                            
        i_reg = 0x01;
    
    __low_power_mode_off_on_exit();                 //进入低功耗模式，当中断响应时被唤醒，从而退出该模式
}

/******************************************************************************************************************
* 函数名称：Beep_Waring()
* 功    能：蜂鸣器报警发声函数。
* 入口参数：n       发声次数
*           t       发声频率
* 出口参数：无
* 说    明：蜂鸣器发声函数根据入口参数t的不同，而发出不同频率的响声。
*           根据n值执行发声次数。    
*******************************************************************************************************************/
void Beep_Waring(unsigned char n, unsigned char t)
{
    do{
        BeepON();                                   //蜂鸣器开
        delay_ms(t);                                //延时鸣叫
        BeepOFF();                                  //蜂鸣器关
        delay_ms(t); 
    }while(--n);
}


